## conf/bblayers.conf.sample
```bitbake
# POKY_BBLAYERS_CONF_VERSION is increased each time build/conf/bblayers.conf
# changes incompatibly
POKY_BBLAYERS_CONF_VERSION = "2"

BBPATH = "${TOPDIR}"
BBFILES ?= ""

BBLAYERS ?= " \
  ##OEROOT##/meta \
  ##OEROOT##/meta-poky \
  ##OEROOT##/meta-yocto-bsp \
  ##OEROOT##/meta-openembedded/meta-filesystems \
  ##OEROOT##/meta-openembedded/meta-gnome \
  ##OEROOT##/meta-openembedded/meta-initramfs \
  ##OEROOT##/meta-openembedded/meta-multimedia \
  ##OEROOT##/meta-openembedded/meta-networking \
  ##OEROOT##/meta-openembedded/meta-oe \
  ##OEROOT##/meta-openembedded/meta-perl \
  ##OEROOT##/meta-openembedded/meta-python \
  ##OEROOT##/meta-openembedded/meta-webserver \
  ##OEROOT##/meta-openembedded/meta-xfce \
  ##OEROOT##/meta-qt5 \
  ##OEROOT##/meta-xilinx/meta-xilinx-bsp \
  ##OEROOT##/meta-linaro/meta-linaro \
  ##OEROOT##/meta-zturn \
  "
```

## conf/layer.conf
```bitbake
# We might have a conf and classes directory, append to BBPATH
BBPATH .= ":${LAYERDIR}"

# We have a recipes directory, add to BBFILES
BBFILES += "${LAYERDIR}/recipes*/*/*.bb ${LAYERDIR}/recipes*/*/*.bbappend"

BBFILE_COLLECTIONS += "meta-zturn"
BBFILE_PATTERN_meta-zturn := "^${LAYERDIR}/"
BBFILE_PRIORITY_meta-zturn = "10"
LAYERDEPENDS_meta-zturn = "core xilinx"
LAYERSERIES_COMPAT_meta-zturn = "sumo"
```

## conf/machine/zturn-zynq7.conf
```bitbake
#@TYPE: Machine
#@NAME: zturn-zynq7
#@DESCRIPTION: Machine support for Z-Turn.

require conf/machine/include/tune-zynq.inc
require conf/machine/include/machine-xilinx-default.inc
require conf/machine/include/machine-xilinx-board.inc

MACHINE_FEATURES = "ext2 vfat usbhost usbgadget"

# u-boot configuration
UBOOT_MACHINE = "zynq_zturn_config"
SPL_BINARY = "boot.bin"

SERIAL_CONSOLE = "115200 ttyPS0"

IMAGE_BOOT_FILES += "boot.bin ${KERNEL_IMAGETYPE}-zynq-zturn.dtb ${KERNEL_IMAGETYPE}-zynq-zturn-xylon.dtb"
```
